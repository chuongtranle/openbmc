## meta-ampere/meta-bonnell/conf/layer.conf
```bitbake
# We have a conf and classes directory, add to BBPATH
BBPATH .= ":${LAYERDIR}"

# We have recipes-* directories, add to BBFILES
BBFILES += "${LAYERDIR}/recipes-*/*/*.bb \
            ${LAYERDIR}/recipes-*/*/*.bbappend"

BBFILE_COLLECTIONS += "bonnell-layer"
BBFILE_PATTERN_bonnell-layer := "^${LAYERDIR}/"
LAYERSERIES_COMPAT_bonnell-layer = "nanbield scarthgap"
```

## meta-ampere/meta-bonnell/conf/machine/mtbonnell.conf
```bitbake
KMACHINE = "aspeed"
KERNEL_DEVICETREE = "aspeed/${KMACHINE}-bmc-ampere-${MACHINE}.dtb"

PREFERRED_PROVIDER_u-boot = "u-boot-aspeed-sdk"
UBOOT_DEVICETREE = "ast2600-ampere"
UBOOT_MACHINE = "ast2600_openbmc_spl_defconfig"
SPL_BINARY = "spl/u-boot-spl.bin"
SOCSEC_SIGN_ENABLE = "0"
SERIAL_CONSOLES = "115200;ttyS4"

require conf/machine/include/ast2600.inc
require conf/machine/include/obmc-bsp-common.inc

# Reformat SPI flash layout to 64MB
FLASH_SIZE = "65536"
FLASH_UBOOT_OFFSET  = "0"
FLASH_KERNEL_OFFSET = "1024"
FLASH_ROFS_OFFSET   = "10240"
FLASH_RWFS_OFFSET   = "43008"

# TODO: will re-enable pbmc-phosphor-fan-mgmt later
MACHINE_FEATURES += "\
        obmc-phosphor-chassis-mgmt \
        obmc-phosphor-flash-mgmt \
        obmc-chassis-state-mgmt \
        obmc-host-state-mgmt \
        obmc-bmc-state-mgmt \
        obmc-host-ipmi \
        "

IMAGE_FEATURES:remove = " \
    obmc-fan-control \
    "

OBMC_COMPATIBLE_NAMES = "com.ampere.Hardware.Chassis.Model.MtBonnell"

OBMC_IMAGE_EXTRA_INSTALL:append = "\
                                   phosphor-ipmi-blobs \
                                   phosphor-ipmi-blobs-binarystore \
                                   ${MACHINE}-gpio-config \
                                   ac01-boot-progress \
                                  "

PREFERRED_PROVIDER_virtual/obmc-chassis-mgmt = "packagegroup-ampere-apps"
PREFERRED_PROVIDER_virtual/obmc-system-mgmt = "packagegroup-ampere-apps"
PREFERRED_PROVIDER_virtual/obmc-host-ipmi-hw = "phosphor-ipmi-ssif"
PREFERRED_PROVIDER_virtual/obmc-flash-mgmt = "packagegroup-ampere-apps"
PREFERRED_PROVIDER_virtual/phosphor-ipmi-fru-hostfw-config ?= "hostboot-inventory-config-native"
```

## meta-openbmc-machines/meta-arm/meta-ampere/conf/layer.conf
```bitbake
# We have a conf and classes directory, add to BBPATH
BBPATH .= ":${LAYERDIR}"

# We have recipes-* directories, add to BBFILES
BBFILES += "${LAYERDIR}/common/recipes-*/*/*.bb \
	    ${LAYERDIR}/common/recipes-*/*/*.bbappend"

BBFILE_COLLECTIONS += "ampere"
BBFILE_PATTERN_ampere = ""
```

## meta-openbmc-machines/meta-arm/meta-ampere/conf/machine/include/ampere.inc
```bitbake
OBMC_MACHINE_FEATURES += "\
        obmc-inventory \
	obmc-phosphor-flash-mgmt \
	obmc-phosphor-chassis-mgmt \
	obmc-chassis-state-mgmt \
        obmc-bmc-state-mgmt \
	obmc-host-ipmi \
        "

PREFERRED_PROVIDER_virtual/obmc-flash-mgmt = "packagegroup-ampere-apps"
PREFERRED_PROVIDER_virtual/obmc-chassis-mgmt = "packagegroup-ampere-apps"
PREFERRED_PROVIDER_virtual/obmc-system-mgmt = "packagegroup-ampere-apps"
PREFERRED_PROVIDER_virtual/obmc-inventory-data ?= "${VIRTUAL-RUNTIME_skeleton_workbook}"
```

## meta-openbmc-machines/meta-arm/meta-ampere/meta-osprey/conf/machine/ampere-osprey.conf
```bitbake
KMACHINE = "aspeed"
KERNEL_DEVICETREE = "${KMACHINE}-bmc-${MACHINE}.dtb"

require conf/machine/include/ast2500.inc
require conf/machine/include/obmc-bsp-common.inc
require conf/machine/include/ampere.inc

UBOOT_MACHINE_ampere-osprey = "ast_g5_phy_config"

FLASH_SIZE = "32768"

VIRTUAL-RUNTIME_skeleton_workbook = "${MACHINE}-config"

PREFERRED_PROVIDER_virtual/obmc-host-ipmi-hw = "phosphor-ipmi-ssif"
```
